## components/wifi_controller/Kconfig
```kconfig
# put here your custom config value
menu "Wi-Fi Controller"
    config SCAN_MAX_AP
        int "Maximun AP scanned"
        default 20
        help
        Maximum number of scanned nearby AP
    menu "cocone1"
        config MGMT_AP_SSID
            string "cocone1 SSID"
            default "ManagementAP"
            help
            SSID of cocone1

        config MGMT_AP_PASSWORD
            string "cocone1 Password"
            default "esp32perchesi"
            help
            Password for cocone1 WPA2 (minimum 8 characters)

        config MGMT_AP_CHANNEL
            int "cocone1 channel"
            range 1 13
            default 3
            help
            Channel on which cocone1 should run
            
        config MGMT_AP_MAX_CONNECTIONS
            int "Maximum number of connected clients"
            range 0 10
            default 1
            help
            Password for cocone1

        config MGMT_AP_AUTH_ON
            bool "Password protected cocone1"
            default y
            help
                If set to true, WPA2-PSK will be used. Otherwise authentication will be open
                and anyone can connect to this cocone1.
    endmenu
endmenu
```
